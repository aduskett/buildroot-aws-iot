## aws/package/aws-crt-python/Config.in
```kconfig
config BR2_PACKAGE_AWS_CRT_PYTHON
	bool "aws-crt-python"
	depends on BR2_INSTALL_LIBSTDCPP
	depends on BR2_PACKAGE_PYTHON3
	select BR2_PACKAGE_PYTHON3_SSL
	select BR2_PACKAGE_AWS_C_AUTH
	select BR2_PACKAGE_AWS_C_CAL
	select BR2_PACKAGE_AWS_C_COMMON
	select BR2_PACKAGE_AWS_C_COMPRESSION
	select BR2_PACKAGE_AWS_C_EVENT_STREAM
	select BR2_PACKAGE_AWS_CHECKSUMS
	select BR2_PACKAGE_AWS_C_HTTP
	select BR2_PACKAGE_AWS_C_IO
	select BR2_PACKAGE_AWS_C_MQTT
	select BR2_PACKAGE_AWS_C_MQTT_WEBSOCKETS
	select BR2_PACKAGE_AWS_C_S3
	select BR2_PACKAGE_AWS_LC
	select BR2_PACKAGE_S2N
	help
	  Python bindings for the AWS Common Runtime.

	  https://github.com/awslabs/aws-crt-python

comment "aws-crt-python needs a toolchain w/ C++"
	depends on !BR2_INSTALL_LIBSTDCPP
```

## aws/package/aws-greengrass-core-v2/Config.in
```kconfig
config BR2_PACKAGE_AWS_GREENGRASS_CORE_V2
	bool "aws-greengrass-core-v2"
	depends on BR2_PACKAGE_HOST_AMAZON_CORRETTO_BIN_ARCH_SUPPORTS # runtime
	depends on BR2_PACKAGE_AMAZON_CORRETTO_BIN
	depends on BR2_TOOLCHAIN_HEADERS_AT_LEAST_3_17
	depends on !BR2_PACKAGE_AWS_GREENGRASS_CORE
	select BR2_PACKAGE_CA_CERTIFICATES # runtime
	select BR2_PACKAGE_NTP # runtime
	select BR2_PACKAGE_SUDO # runtime
	help
	  The Greengrass nucleus component provides functionality for
	  device side orchestration of deployments and lifecycle
	  management for execution of Greengrass components and
	  applications. This includes features such as starting,
	  stopping, and monitoring execution of components and apps,
	  interprocess communication server for communication between
	  components, component installation and configuration
	  management.

	  https://github.com/aws-greengrass/aws-greengrass-nucleus

comment "aws-greengrass-core-v2 requires Corretto Java"
	depends on BR2_PACKAGE_HOST_AMAZON_CORRETTO_BIN_ARCH_SUPPORTS
	depends on !BR2_PACKAGE_AWS_GREENGRASS_CORE
	depends on !BR2_PACKAGE_AMAZON_CORRETTO_BIN

comment "aws-greengrass-core-v2 needs headers >= 3.17"
	depends on !BR2_TOOLCHAIN_HEADERS_AT_LEAST_3_17
```

## aws/package/aws-greengrass-core/Config.in
```kconfig
# Taken from make/autoconf/platform.m4
config BR2_PACKAGE_AWS_GREENGRASS_CORE_ARCH_SUPPORTS
	bool
	default y if BR2_aarch64
	default y if BR2_arm
	default y if BR2_x86_64

config BR2_PACKAGE_AWS_GREENGRASS_CORE
	bool "aws-greengrass-core"
	depends on BR2_PACKAGE_AWS_GREENGRASS_CORE_ARCH_SUPPORTS
	depends on BR2_TOOLCHAIN_HEADERS_AT_LEAST_3_17
	help
	  AWS IoT Greengrass seamlessly extends AWS to edge devices so
	  they can act locally on the data they generate, while
	  still using the cloud for management, analytics, and durable
	  storage. With AWS IoT Greengrass, connected devices can run
	  AWS Lambda functions, Docker containers, or both,
	  execute predictions based on machine learning models, keep
	  device data in sync, and communicate with other devices
	  securely – even when not connected to the Internet.

	  https://aws.amazon.com/greengrass/

if BR2_PACKAGE_AWS_GREENGRASS_CORE

# Dependencies from:
# https://docs.aws.amazon.com/greengrass/latest/developerguide/what-is-gg.html
config BR2_PACKAGE_AWS_GREENGRASS_CORE_OTA_AGENT
	bool "over-the-air (OTA) update agent support"
	depends on BR2_PACKAGE_BUSYBOX_SHOW_OTHERS
	depends on BR2_USE_MMU # tar, wget, procps-ng
	depends on BR2_USE_WCHAR # tar, wget
	select BR2_PACKAGE_BASH
	select BR2_PACKAGE_CA_CERTIFICATES
	select BR2_PACKAGE_COREUTILS
	select BR2_PACKAGE_FINDUTILS
	select BR2_PACKAGE_GREP
	select BR2_PACKAGE_GZIP
	select BR2_PACKAGE_OPENSSL
	select BR2_PACKAGE_PROCPS_NG # pidof
	select BR2_PACKAGE_TAR
	select BR2_PACKAGE_UTIL_LINUX
	select BR2_PACKAGE_UTIL_LINUX_MOUNT
	select BR2_PACKAGE_WGET

comment "OTA update agent needs a toolchain w/ dynamic library, wchar"
	depends on BR2_USE_MMU
	depends on !BR2_USE_WCHAR
	depends on BR2_PACKAGE_BUSYBOX_SHOW_OTHERS

config BR2_PACKAGE_AWS_GREENGRASS_CORE_STREAM_MANAGER
	bool "stream manager support"
	depends on BR2_PACKAGE_HOST_AMAZON_CORRETTO_BIN_ARCH_SUPPORTS
	depends on BR2_PACKAGE_AMAZON_CORRETTO_BIN

comment "Stream support requires Corretto Java"
	depends on BR2_PACKAGE_HOST_AMAZON_CORRETTO_BIN_ARCH_SUPPORTS
	depends on !BR2_PACKAGE_AMAZON_CORRETTO_BIN

config BR2_PACKAGE_AWS_GREENGRASS_CORE_ARCH
	string
	default "aarch64" if BR2_ARM_CPU_ARMV8A
	default "armv6l"  if BR2_ARM_CPU_ARMV6
	default "armv7l"  if BR2_ARM_CPU_ARMV7A || BR2_ARM_CPU_ARMV7M
	default "x86-64"  if BR2_x86_64

endif

comment "aws-greengrass-core needs headers >= 3.17"
	depends on !BR2_TOOLCHAIN_HEADERS_AT_LEAST_3_17
```

## aws/package/aws-iot-device-client/Config.in
```kconfig
config BR2_PACKAGE_AWS_IOT_DEVICE_CLIENT
	bool "aws-iot-device-client"
	depends on BR2_INSTALL_LIBSTDCPP
	select BR2_PACKAGE_AWS_C_AUTH
	select BR2_PACKAGE_AWS_C_CAL
	select BR2_PACKAGE_AWS_C_COMMON
	select BR2_PACKAGE_AWS_C_COMPRESSION
	select BR2_PACKAGE_AWS_C_EVENT_STREAM
	select BR2_PACKAGE_AWS_CHECKSUMS
	select BR2_PACKAGE_AWS_C_HTTP
	select BR2_PACKAGE_AWS_C_IO
	select BR2_PACKAGE_AWS_C_MQTT
	select BR2_PACKAGE_AWS_C_MQTT_WEBSOCKETS
	select BR2_PACKAGE_AWS_CRT_CPP
	select BR2_PACKAGE_AWS_C_S3
	select BR2_PACKAGE_AWS_IOT_DEVICE_SDK_CPP_V2
	select BR2_PACKAGE_OPENSSL
	help
	  The AWS IoT Device Client is free, open-source, modular
	  software written in C++ that you can compile and install on
	  your Embedded Linux based IoT devices to access AWS IoT Core,
	  AWS IoT Device Management, and AWS IoT Device Defender
	  features by default. It serves as a reference implementation
	  for your IoT devices to work with AWS IoT services, with
	  operational best practices baked in – using it is the easiest
	  way to create a proof-of-concept (PoC) for your IoT project.
	  What’s more, since it is open-source, you can modify it to fit
	  your business needs, or optimize it when you wish to scale up
	  from a PoC to production.

	  Notice: Running the AWS IoT Device Client will incur usage of
	  AWS IoT services, and is likely to incur charges on your AWS
	  account. Please refer the pricing pages for AWS IoT Core, AWS
	  IoT Device Management, and AWS IoT Device Defender for more
	  details.

	  https://github.com/awslabs/aws-iot-device-client

if BR2_PACKAGE_AWS_IOT_DEVICE_CLIENT

config BR2_PACKAGE_AWS_IOT_DEVICE_CLIENT_INSTALL_SETUP_SCRIPT
	  bool "Install setup script"
	  help
	    Install the setup.sh script to
	    /usr/bin/aws-iot-device-client-setup. Otherwise, the
	    configuration file will have to be manually generated.

config BR2_PACKAGE_AWS_IOT_DEVICE_CLIENT_JOBS
	bool "Jobs"
	help
	  The Jobs feature within the AWS IoT Device Client provides
	  device-side functionality for execution of jobs created. When
	  the Jobs feature starts within the AWS IoT Device Client, the
	  feature will attempt to establish subscriptions to important
	  notification topics, and will also publish a request to
	  receive the latest pending jobs. It will use the shared
	  MQTT connection to subscribe/publish to these topics.

	  https://github.com/awslabs/aws-iot-device-client/blob/main/source/jobs/README.md

config BR2_PACKAGE_AWS_IOT_DEVICE_CLIENT_DD
	bool "Device Defender"
	help
	  The Device Defender feature within the AWS IoT Device Client
	  publishes device-side metrics about the device to the cloud.
	  You can then use the cloud-side service to identify unusual
	  behavior that might indicate a compromised device by
	  monitoring the behavior of your devices.

	  https://github.com/awslabs/aws-iot-device-client/blob/main/source/devicedefender/README.md

config BR2_PACKAGE_AWS_IOT_DEVICE_CLIENT_ST
	bool "Secure Tunneling"
	help
	  The Secure Tunneling feature allows you to gain access to a
	  remote device even if the device is behind a firewall.
	  You may want to remote access to a device to troubleshoot, or
	  update its configuration.

	  https://github.com/awslabs/aws-iot-device-client/blob/main/source/tunneling/README.md

config BR2_PACKAGE_AWS_IOT_DEVICE_CLIENT_FP
	bool "Fleet provisioning"
	help
	  The AWS IoT Device Client has the capability to provision your
	  IoT device when you connect it to AWS IoT Core for the first
	  time. The device client provides two different mechanisms for
	  provisioning your device (1) using a claim certificate and
	  private key and (2) using a CSR file
	  (along with claim certificate and key) to securely provision
	  the device while keeping the user private key secure.

	  After all required information is provided, the Fleet
	  Provisioning Feature will provision, register the device with
	  AWS IoT Core, and then establish a connection to IoT Core
	  that is ready for use by other Device Client features.

	  https://github.com/awslabs/aws-iot-device-client/blob/main/source/fleetprovisioning/README.md

config BR2_PACKAGE_AWS_IOT_DEVICE_CLIENT_SAMPLES
	bool "Build samples"
	help
	  Build sample features

config BR2_PACKAGE_AWS_IOT_DEVICE_CLIENT_PUBSUB_SAMPLES
	bool "Pubsub samples"
	help
	  The Pub Sub sample feature was designed to illustrate how
	  you might take advantage of the shared mqtt connection that
	  exists in the SharedCrtResourceManager. The Pub Sub sample
	  feature will publish data from a configured publish-file to
	  a publish-topic, and will recieve messages on a configured
	  subscribe-topic and write them to a subscribe-file.

	  https://github.com/awslabs/aws-iot-device-client/blob/main/source/samples/pubsub/README.md

config BR2_PACKAGE_AWS_IOT_DEVICE_CLIENT_SHADOW
	bool "Shadow"
	help
	  The AWS IoT Device Shadow service adds shadows to AWS IoT
	  thing objects, which provides a reliable data store for
	  devices, apps, and other cloud services to share data.
	  The client-side Named Shadows feature enables you to control
	  your IoT device using AWS IoT Named Shadows. Shadows can store
	  your device's state information and make it available to your
	  device, AWS IoT services, your custom apps and other AWS
	  services whether the device is online and connected to AWS IoT
	  or not.

	  https://github.com/awslabs/aws-iot-device-client/blob/main/source/shadow/README.md

if BR2_PACKAGE_AWS_IOT_DEVICE_CLIENT_SHADOW

config BR2_PACKAGE_AWS_IOT_DEVICE_CLIENT_SHADOW_CONFIG
	bool "Shadow config"
	help
	  Build the device client with the IoT Config Shadow features.

config BR2_PACKAGE_AWS_IOT_DEVICE_CLIENT_SHADOW_SAMPLES
	bool "Shadow sample"
	help
	  Build the device client with the IoT sample shadow feature.

endif # if BR2_PACKAGE_AWS_IOT_DEVICE_CLIENT_SHADOW

endif # if BR2_PACKAGE_AWS_IOT_DEVICE_CLIENT

comment "aws-iot-device-client needs a toolchain w/ C++"
	depends on !BR2_INSTALL_LIBSTDCPP
```

## aws/package/aws-iot-device-sdk-cpp-v2/Config.in
```kconfig
config BR2_PACKAGE_AWS_IOT_DEVICE_SDK_CPP_V2
	bool "aws-iot-device-sdk-cpp-v2"
	depends on BR2_INSTALL_LIBSTDCPP # aws-crt-cpp
	select BR2_PACKAGE_AWS_C_IO
	select BR2_PACKAGE_AWS_C_IOT
	select BR2_PACKAGE_AWS_CRT_CPP
	help
	  Next generation AWS IoT Client SDK for C++ using the AWS
	  Common Runtime

	  https://github.com/aws/aws-iot-device-sdk-cpp-v2

comment "aws-iot-device-sdk-cpp-v2 needs a toolchain w/ C++"
	depends on !BR2_INSTALL_LIBSTDCPP
```

## aws/package/aws-iot-securetunneling-localproxy/Config.in
```kconfig
config BR2_PACKAGE_AWS_IOT_SECURETUNNELING_LOCALPROXY
	bool "aws-iot-securetunneling-localproxy"
	depends on BR2_PACKAGE_PROTOBUF_ARCH_SUPPORTS
	depends on BR2_TOOLCHAIN_HAS_THREADS_NPTL # boost log
	depends on BR2_TOOLCHAIN_HAS_THREADS # boost, protobuf-c
	depends on BR2_TOOLCHAIN_GCC_AT_LEAST_4_8 # C++11
	depends on !BR2_STATIC_LIBS # protobuf
	depends on BR2_INSTALL_LIBSTDCPP # boost, protobuf
	depends on BR2_USE_WCHAR # boost
	select BR2_PACKAGE_BOOST
	select BR2_PACKAGE_BOOST_SYSTEM
	select BR2_PACKAGE_BOOST_LOG
	select BR2_PACKAGE_BOOST_THREAD
	select BR2_PACKAGE_BOOST_PROGRAM_OPTIONS
	select BR2_PACKAGE_BOOST_DATE_TIME
	select BR2_PACKAGE_BOOST_FILESYSTEM
	select BR2_PACKAGE_PROTOBUF
	help
	  Example C++ implementation of a local proxy for the AWS IoT
	  Secure Tunneling service

	  https://github.com/aws-samples/aws-iot-securetunneling-localproxy

comment "aws-iot-securetunneling-localproxy needs a toolchain w/ C++, threads, NPTL, dynamic library, wchar, gcc >= 4.8"
	depends on !BR2_INSTALL_LIBSTDCPP || !BR2_TOOLCHAIN_HAS_THREADS \
		|| BR2_STATIC_LIBS || !BR2_USE_WCHAR || \
		!BR2_TOOLCHAIN_GCC_AT_LEAST_4_8 || \
		!BR2_TOOLCHAIN_HAS_THREADS_NPTL
	depends on BR2_PACKAGE_PROTOBUF_ARCH_SUPPORTS
```

## aws/package/aws-lambda-cpp/Config.in
```kconfig
config BR2_PACKAGE_AWS_LAMBDA_CPP
	bool "aws-lambda-cpp"
	depends on BR2_TOOLCHAIN_GCC_AT_LEAST_5
	depends on BR2_INSTALL_LIBSTDCPP
	select BR2_PACKAGE_LIBCURL
	select BR2_PACKAGE_ZIP
	help
	  C++ implementation of the AWS lambda runtime API.

	  https://github.com/awslabs/aws-lambda-cpp

comment "aws-lambda-cpp needs a toolchain w/ C++, gcc >= 5"
	depends on !BR2_INSTALL_LIBSTDCPP || \
		!BR2_TOOLCHAIN_GCC_AT_LEAST_5
```

## aws/package/aws-lc/Config.in
```kconfig
config BR2_PACKAGE_AWS_LC
	bool "aws-libcrypto"
	select BR2_PACKAGE_OPENSSL
	help
	  AWS-LC is a general-purpose cryptographic library maintained
	  by the AWS Cryptography team for AWS and their customers. It
	  іs based on code from the Google BoringSSL project and the
	  OpenSSL project.

	  AWS-LC contains portable C implementations of algorithms
	  needed for TLS and common applications. For performance
	  critical algorithms, optimized assembly versions are
	  included for x86 and ARM.

	  https://github.com/awslabs/aws-lc
```

## aws/package/aws-sdk-cpp/Config.in
```kconfig
config BR2_PACKAGE_AWS_SDK_CPP
	bool "aws-sdk-cpp"
	depends on BR2_TOOLCHAIN_USES_GLIBC
	depends on BR2_INSTALL_LIBSTDCPP
	select BR2_PACKAGE_AWS_C_CAL
	select BR2_PACKAGE_AWS_C_EVENT_STREAM
	select BR2_PACKAGE_AWS_CRT_CPP
	select BR2_PACKAGE_ZLIB
	help
	  The AWS SDK for C++ provides a modern C++ (C++ 11 or later)
	  interface for Amazon Web Services (AWS). It is meant to be
	  performant and fully functioning with low- and high-level
	  SDKs, while minimizing dependencies and providing platform
	  portability (Windows, OSX, Linux, and mobile).

	  https://github.com/aws/aws-sdk-cpp

if BR2_PACKAGE_AWS_SDK_CPP

config BR2_PACKAGE_AWS_SDK_CPP_EXTRA_MODULES
	string "extra modules to build"
	default ""
	help
	  A semi-colon delimited list of extra modules to build.
	  By default, only the core module is built.

config BR2_PACKAGE_AWS_SDK_CPP_HTTP_CLIENT
	bool "http client"
	select BR2_PACKAGE_LIBCURL
	help
	  If disabled, no platform-default http client will be included
	  in the library.  For the library to be used you will need to
	  provide your own platform-specific implementation

config BR2_PACKAGE_AWS_SDK_CPP_TEXT_TO_SPEECH
	bool "text-to-speech support"
	depends on BR2_PACKAGE_PULSEAUDIO_HAS_ATOMIC # pulseaudio
	depends on BR2_USE_WCHAR # pulseaudio
	depends on !BR2_STATIC_LIBS # pulseaudio
	depends on BR2_USE_MMU # pulseaudio -> fork()
	select BR2_PACKAGE_PULSEAUDIO
	help
	  text-to-speech plugin

comment "text-to-speech support needs a toolchain w/ wchar, threads, dynamic library"
	depends on BR2_USE_MMU
	depends on BR2_PACKAGE_PULSEAUDIO_HAS_ATOMIC
	depends on !BR2_USE_WCHAR || !BR2_TOOLCHAIN_HAS_THREADS || BR2_STATIC_LIBS

endif

comment "aws-sdk-cpp needs a glibc toolchain w/ C++"
	depends on !BR2_TOOLCHAIN_USES_GLIBC || !BR2_INSTALL_LIBSTDCPP
```

## aws/package/aws-sdk-go-v2/Config.in
```kconfig
config BR2_PACKAGE_AWS_SDK_GO_V2
	bool "aws-sdk-go-v2"
	depends on BR2_PACKAGE_HOST_GO_TARGET_ARCH_SUPPORTS
	depends on BR2_PACKAGE_HOST_GO_TARGET_CGO_LINKING_SUPPORTS
	help
	  aws-sdk-go-v2 is the v2 AWS SDK for the Go programming
	  language.

	  https://github.com/aws/aws-sdk-go-v2
```
