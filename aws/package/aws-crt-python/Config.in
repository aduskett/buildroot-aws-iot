## aws/package/aws-sdk-java-v2/Config.in
```kconfig
config BR2_PACKAGE_AWS_SDK_JAVA_V2
	bool "aws-sdk-java-v2"
	depends on BR2_PACKAGE_HOST_AMAZON_CORRETTO_BIN_ARCH_SUPPORTS
	depends on BR2_AMAZON_CORRETTO_BIN_VERSION_LATEST
	help
	  The AWS SDK for Java 2.0 is a rewrite of 1.0 with some great
	  new features. As with version 1.0, it enables you to easily
	  work with Amazon Web Services but also includes features like
	  non-blocking IO and pluggable HTTP implementation to further
	  customize your applications.

	  https://github.com/aws/aws-sdk-java-v2

comment "aws-sdk-java-v2 needs amazon-corretto-bin current"
	depends on BR2_PACKAGE_HOST_AMAZON_CORRETTO_BIN_ARCH_SUPPORTS
	depends on !BR2_AMAZON_CORRETTO_BIN_VERSION_LATEST
```

## aws/package/aws-sdk-java/Config.in
```kconfig
config BR2_PACKAGE_AWS_SDK_JAVA
	bool "aws-sdk-java"
	depends on BR2_PACKAGE_HOST_AMAZON_CORRETTO_BIN_ARCH_SUPPORTS
	depends on BR2_AMAZON_CORRETTO_BIN_VERSION_8
	help
	  The AWS SDK for Java enables Java developers to easily work
	  with Amazon Web Services and build scalable solutions with
	  Amazon S3, Amazon DynamoDB, Amazon Glacier, and more.

	  https://github.com/aws/aws-sdk-java

comment "aws-sdk-java needs amazon-corretto-bin 8"
	depends on BR2_PACKAGE_HOST_AMAZON_CORRETTO_BIN_ARCH_SUPPORTS
	depends on !BR2_AMAZON_CORRETTO_BIN_VERSION_8
```

## aws/package/python-awscli/Config.in
```kconfig
config BR2_PACKAGE_PYTHON_AWSCLI
	bool "python-awscli"
	depends on BR2_PACKAGE_PYTHON3
	select BR2_PACKAGE_PYTHON_DISTRO # runtime
	select BR2_PACKAGE_PYTHON_RUAMEL_YAML # runtime
	help
	  The AWS Command Line Interface (CLI) is a unified tool to
	  manage your AWS services. With just one tool to download and
	  configure, you can control multiple AWS services from the
	  command line and automate them through scripts.

	  https://aws.amazon.com/cli/
```

## aws/package/python-distro/Config.in
```kconfig
config BR2_PACKAGE_PYTHON_DISTRO
	bool "python-distro"
	depends on BR2_PACKAGE_PYTHON3
	help
	  Distro provides information about the OS distribution it runs
	  on, such as a reliable machine-readable ID, or version
	  information.

	  https://github.com/python-distro/distro
```

## aws/package/s2n/Config.in
```kconfig
config BR2_PACKAGE_S2N
	bool "s2n"
	select BR2_PACKAGE_OPENSSL
	help
	  s2n is a C99 implementation of the TLS/SSL protocols that is
	  designed to be simple, small, fast, and with security as a
	  priority. It is released and licensed under the Apache
	  License 2.0.

	  https://github.com/awslabs/s2n
```

## package/amazon-kinesis-video-streams-producer-c/Config.in
```kconfig
config BR2_PACKAGE_AMAZON_KINESIS_VIDEO_STREAMS_PRODUCER_C
	bool "amazon-kinesis-video-streams-producer-c"
	depends on BR2_TOOLCHAIN_HAS_THREADS
	select BR2_PACKAGE_AMAZON_KINESIS_VIDEO_STREAMS_PIC
	select BR2_PACKAGE_JSMN
	select BR2_PACKAGE_LIBCURL
	select BR2_PACKAGE_OPENSSL
	help
	  Amazon Kinesis Video Streams Webrtc SDK is for developers to
	  install and customize realtime communication between devices
	  and enable secure streaming of video, audio to Kinesis Video
	  Streams.

	  https://github.com/awslabs/amazon-kinesis-video-streams-webrtc-sdk-c

if BR2_PACKAGE_AMAZON_KINESIS_VIDEO_STREAMS_PRODUCER_C

config BR2_PACKAGE_AMAZON_KINESIS_VIDEO_STREAMS_PRODUCER_C_WEBSOCKETS
	bool "websockets support"
	select BR2_PACKAGE_LIBWEBSOCKETS

endif

comment "amazon-kinesis-video-streams-producer-c needs a toolchain w/ threads"
	depends on !BR2_TOOLCHAIN_HAS_THREADS
```

## package/amazon-kinesis-video-streams-webrtc-sdk-c/Config.in
```kconfig
config BR2_PACKAGE_AMAZON_KINESIS_VIDEO_STREAMS_WEBRTC_SDK_C
	bool "amazon-kinesis-video-streams-webrtc-sdk-c"
	depends on BR2_TOOLCHAIN_HAS_THREADS
	select BR2_PACKAGE_AMAZON_KINESIS_VIDEO_STREAMS_PRODUCER_C
	select BR2_PACKAGE_AMAZON_KINESIS_VIDEO_STREAMS_PRODUCER_C_WEBSOCKETS
	select BR2_PACKAGE_OPENSSL
	select BR2_PACKAGE_USRSCTP
	help
	  Amazon Kinesis Video Streams Webrtc SDK is for developers to
	  install and customize realtime communication between devices
	  and enable secure streaming of video, audio to Kinesis Video
	  Streams.

	  https://github.com/awslabs/amazon-kinesis-video-streams-webrtc-sdk-c

comment "amazon-kinesis-video-streams-webrtc-sdk-c needs a toolchain w/ threads"
	depends on !BR2_TOOLCHAIN_HAS_THREADS
```

## package/aws-c-auth/Config.in
```kconfig
config BR2_PACKAGE_AWS_C_AUTH
	bool "aws-c-auth"
	depends on BR2_TOOLCHAIN_HAS_THREADS_NPTL # aws-c-common -> pthread_setaffinity_np
	depends on !BR2_TOOLCHAIN_USES_MUSL # aws-c-common -> pthread_attr_setaffinity_np
	select BR2_PACKAGE_AWS_C_CAL
	select BR2_PACKAGE_AWS_C_COMMON
	select BR2_PACKAGE_AWS_C_HTTP
	select BR2_PACKAGE_AWS_C_IO
	help
	  C99 library implementation of AWS client-side authentication:
	  standard credentials providers and signing.

	  https://github.com/awslabs/aws-c-auth

comment "aws-c-auth needs glibc or uClibc toolchain w/ NPTL"
	depends on !BR2_TOOLCHAIN_HAS_THREADS_NPTL || BR2_TOOLCHAIN_USES_MUSL
```

## package/aws-c-cal/Config.in
```kconfig
config BR2_PACKAGE_AWS_C_CAL
	bool "aws-c-cal"
	depends on BR2_TOOLCHAIN_HAS_THREADS_NPTL # aws-c-auth -> pthread_setaffinity_np
	select BR2_PACKAGE_AWS_C_COMMON
	select BR2_PACKAGE_OPENSSL
	help
	  AWS Crypto Abstraction Layer: Cross-Platform, C99 wrapper for
	  cryptography primitives.

	  https://github.com/awslabs/aws-c-cal

comment "aws-c-cal needs a toolchain w/ NPTL"
	depends on !BR2_TOOLCHAIN_HAS_THREADS_NPTL
```

## package/aws-c-common/Config.in
```kconfig
config BR2_PACKAGE_AWS_C_COMMON
	bool "aws-c-common"
	depends on BR2_TOOLCHAIN_HAS_THREADS
	help
	  Core c99 package for AWS SDK for C. Includes
	  cross-platform primitives, configuration, data structures,
	  and error handling.

	  https://github.com/awslabs/aws-c-common

comment "aws-c-common needs a toolchain w/ threads"
	depends on !BR2_TOOLCHAIN_HAS_THREADS
```

## package/aws-c-compression/Config.in
```kconfig
config BR2_PACKAGE_AWS_C_COMPRESSION
	bool "aws-c-compression"
	depends on BR2_TOOLCHAIN_HAS_THREADS_NPTL # aws-c-auth -> pthread_setaffinity_np
	select BR2_PACKAGE_AWS_C_COMMON
	help
	  This is a cross-platform C99 implementation of compression
	  algorithms such as gzip, and huffman encoding/decoding.
	  Currently only huffman is implemented.

	  https://github.com/awslabs/aws-c-compression

comment "aws-c-compression a needs toolchain w/ NPTL"
	depends on !BR2_TOOLCHAIN_HAS_THREADS_NPTL
```

## package/aws-c-event-stream/Config.in
```kconfig
config BR2_PACKAGE_AWS_C_EVENT_STREAM
	bool "aws-c-event-stream"
	depends on BR2_TOOLCHAIN_HAS_THREADS_NPTL # aws-c-io -> aws-c-common -> pthread_setaffinity_np
	select BR2_PACKAGE_AWS_C_IO
	select BR2_PACKAGE_AWS_CHECKSUMS
	help
	  C99 implementation of the vnd.amazon.event-stream
	  content-type.

	  https://github.com/awslabs/aws-c-event-stream

comment "aws-c-event-stream needs a toolchain w/ NPTL"
	depends on !BR2_TOOLCHAIN_HAS_THREADS_NPTL
```

## package/aws-c-http/Config.in
```kconfig
config BR2_PACKAGE_AWS_C_HTTP
	bool "aws-c-http"
	depends on BR2_TOOLCHAIN_HAS_THREADS_NPTL # aws-c-common -> pthread_setaffinity_np
	select BR2_PACKAGE_AWS_C_COMPRESSION
	select BR2_PACKAGE_AWS_C_IO
	help
	  C99 implementation of the HTTP/1.1 and HTTP/2 specifications

	  https://github.com/awslabs/aws-c-http

comment "aws-c-http needs a toolchain w/ NPTL"
	depends on !BR2_TOOLCHAIN_HAS_THREADS_NPTL
```

## package/aws-c-io/Config.in
```kconfig
config BR2_PACKAGE_AWS_C_IO
	bool "aws-c-io"
	depends on BR2_TOOLCHAIN_HAS_THREADS_NPTL # aws-c-common -> pthread_setaffinity_np
	depends on !BR2_TOOLCHAIN_USES_MUSL # aws-c-common -> pthread_attr_setaffinity_np
	select BR2_PACKAGE_AWS_C_COMMON
	select BR2_PACKAGE_S2N
	help
	  This is a module for the AWS SDK for C. It handles all IO and
	  TLS work for application protocols.

	  aws-c-io is an event driven framework for implementing
	  application protocols. It is built on top of cross-platform
	  abstractions that allow you as a developer to think only about
	  the state machine and API for your protocols. A typical
	  use-case would be to write something like Http on top of
	  asynchronous-io with TLS already baked in. All of the platform
	  and security concerns are already handled for you.

	  It is designed to be light-weight, fast, portable, and
	  flexible for multiple domain use-cases such as: embedded,
	  server, client, and mobile.

	  https://github.com/awslabs/aws-c-io

comment "aws-c-io needs glibc or uClibc toolchain w/ NPTL"
	depends on !BR2_TOOLCHAIN_HAS_THREADS_NPTL || BR2_TOOLCHAIN_USES_MUSL
```

## package/aws-c-iot/Config.in
```kconfig
config BR2_PACKAGE_AWS_C_IOT
	bool "aws-c-iot"
	depends on BR2_TOOLCHAIN_HAS_THREADS_NPTL # aws-c-common -> pthread_setaffinity_np
	depends on !BR2_TOOLCHAIN_USES_MUSL # aws-c-common -> pthread_attr_setaffinity_np
	select BR2_PACKAGE_AWS_C_COMMON
	select BR2_PACKAGE_AWS_C_IO
	select BR2_PACKAGE_AWS_C_MQTT
	help
	  C99 implementation of AWS IoT cloud services integration with
	  devices

	  https://github.com/awslabs/aws-c-iot

comment "aws-c-iot needs glibc or uClibc toolchain w/ NPTL"
	depends on !BR2_TOOLCHAIN_HAS_THREADS_NPTL || BR2_TOOLCHAIN_USES_MUSL
```
