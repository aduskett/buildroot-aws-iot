## package/aws-c-mqtt/Config.in
```kconfig
config BR2_PACKAGE_AWS_C_MQTT
	bool "aws-c-mqtt"
	depends on BR2_TOOLCHAIN_HAS_THREADS_NPTL # aws-c-common -> pthread_setaffinity_np
	depends on !BR2_TOOLCHAIN_USES_MUSL # aws-c-common -> pthread_attr_setaffinity_np
	select BR2_PACKAGE_AWS_C_IO
	help
	  C99 implementation of the MQTT/1.1 and MQTT/2 specifications

	  https://github.com/awslabs/aws-c-mqtt

if BR2_PACKAGE_AWS_C_MQTT

config BR2_PACKAGE_AWS_C_MQTT_WEBSOCKETS
	bool "websocket support"
	select BR2_PACKAGE_AWS_C_HTTP
	help
	  Enable MQTT connections over websockets.

endif

comment "aws-c-mqtt needs glibc or uClibc toolchain w/ NPTL"
	depends on !BR2_TOOLCHAIN_HAS_THREADS_NPTL || BR2_TOOLCHAIN_USES_MUSL
```

## package/aws-c-s3/Config.in
```kconfig
config BR2_PACKAGE_AWS_C_S3
	bool "aws-c-s3"
	depends on BR2_TOOLCHAIN_HAS_THREADS_NPTL # aws-c-common -> pthread_setaffinity_np
	depends on !BR2_TOOLCHAIN_USES_MUSL # aws-c-common -> pthread_attr_setaffinity_np
	select BR2_PACKAGE_AWS_C_AUTH
	select BR2_PACKAGE_AWS_C_HTTP
	help
	  C99 library implementation for communicating with the S3
	  service, designed for maximizing throughput on high
	  bandwidth EC2 instances.

	  https://github.com/awslabs/aws-c-s3

comment "aws-c-s3 needs glibc or uClibc toolchain w/ NPTL"
	depends on !BR2_TOOLCHAIN_HAS_THREADS_NPTL || BR2_TOOLCHAIN_USES_MUSL
```

## package/aws-crt-cpp/Config.in
```kconfig
config BR2_PACKAGE_AWS_CRT_CPP
	bool "aws-crt-cpp"
	depends on BR2_INSTALL_LIBSTDCPP
	depends on BR2_TOOLCHAIN_HAS_THREADS_NPTL # aws-c-common -> pthread_setaffinity_np
	select BR2_PACKAGE_AWS_C_AUTH
	select BR2_PACKAGE_AWS_C_CAL
	select BR2_PACKAGE_AWS_CHECKSUMS
	select BR2_PACKAGE_AWS_C_EVENT_STREAM
	select BR2_PACKAGE_AWS_C_HTTP
	select BR2_PACKAGE_AWS_C_MQTT
	help
	  C++ wrapper around the aws-c-* libraries. Provides
	  Cross-Platform Transport Protocols and SSL/TLS
	  implementations for C++.

	  https://github.com/awslabs/aws-crt-cpp

comment "aws-crt-cpp needs a toolchain w/ NTPL, C++"
	depends on !BR2_INSTALL_LIBSTDCPP || !BR2_TOOLCHAIN_HAS_THREADS_NPTL
```

## package/aws-crt-python/Config.in
```kconfig
config BR2_PACKAGE_AWS_CRT_PYTHON
	bool "aws-crt-python"
	depends on BR2_INSTALL_LIBSTDCPP
	depends on BR2_TOOLCHAIN_HAS_THREADS # aws-c-common
	depends on BR2_PACKAGE_PYTHON || BR2_PACKAGE_PYTHON3
	select BR2_PACKAGE_PYTHON_SSL if BR2_PACKAGE_PYTHON
	select BR2_PACKAGE_PYTHON3_SSL if BR2_PACKAGE_PYTHON3
	select BR2_PACKAGE_AWS_C_AUTH
	select BR2_PACKAGE_AWS_C_CAL
	select BR2_PACKAGE_AWS_C_COMMON
	select BR2_PACKAGE_AWS_C_COMPRESSION
	select BR2_PACKAGE_AWS_C_EVENT_STREAM
	select BR2_PACKAGE_AWS_C_HTTP
	select BR2_PACKAGE_AWS_C_IO
	select BR2_PACKAGE_AWS_C_MQTT
	select BR2_PACKAGE_AWS_C_S3
	select BR2_PACKAGE_PYTHON_ENUM34 if BR2_PACKAGE_PYTHON
	select BR2_PACKAGE_PYTHON_FUTURES if BR2_PACKAGE_PYTHON
	select BR2_PACKAGE_S2N
	help
	  Python bindings for the AWS Common Runtime.

	  https://github.com/awslabs/aws-crt-python

comment "aws-crt-python needs a toolchain w/ threads, C++"
	depends on !BR2_INSTALL_LIBSTDCPP || !BR2_TOOLCHAIN_HAS_THREADS
```

## package/aws-greengrass-core-sdk-c/Config.in
```kconfig
config BR2_PACKAGE_AWS_GREENGRASS_CORE_SDK_C
	bool "aws-greengrass-core-sdk-c"
	depends on BR2_PACKAGE_AWS_GREENGRASS_CORE_ARCH_SUPPORTS
	depends on BR2_TOOLCHAIN_HEADERS_AT_LEAST_3_17
	select BR2_PACKAGE_AWS_GREENGRASS_CORE # runtime
	help
	  The AWS Greengrass Core SDK for C provides an interface to
	  interact with the Greengrass Core system on the edge. It is
	  c89 compliant and is meant to be performant while minimizing
	  dependencies.

	  https://github.com/aws/aws-greengrass-core-sdk-c

comment "aws-greengrass-core-sdk-c needs a toolchain w/ headers >= 3.17"
	depends on BR2_PACKAGE_GREENGRASS_ARCH_SUPPORTS
	depends on !BR2_INSTALL_LIBSTDCPP || !BR2_TOOLCHAIN_HAS_THREADS
```

## package/aws-greengrass-core-sdk-python/Config.in
```kconfig
config BR2_PACKAGE_AWS_GREENGRASS_CORE_SDK_PYTHON
	bool "aws-greengrass-core-sdk-python"
	depends on BR2_PACKAGE_AWS_GREENGRASS_CORE_ARCH_SUPPORTS
	depends on BR2_TOOLCHAIN_HEADERS_AT_LEAST_3_17
	depends on BR2_PACKAGE_PYTHON || BR2_PACKAGE_PYTHON3
	select BR2_PACKAGE_PYTHON_SSL if BR2_PACKAGE_PYTHON
	select BR2_PACKAGE_PYTHON3_SSL if BR2_PACKAGE_PYTHON3
	select BR2_PACKAGE_AWS_GREENGRASS_CORE
	select BR2_PACKAGE_PYTHON_CBOR2

	help
	  The AWS IoT Greengrass Core SDK is meant to be used by AWS
	  Lambda functions running on an AWS IoT Greengrass Core.
	  It will enable Lambda functions to invoke other Lambda
	  functions deployed to the Greengrass Core, publish
	  messages to the Greengrass Core and work with the local
	  Shadow service.

	  https://github.com/aws/aws-greengrass-core-sdk-python

comment "aws-greengrass-core-python needs a toolchain w/ headhers >= 3.17"
	depends on BR2_PACKAGE_GREENGRASS_ARCH_SUPPORTS
	depends on !BR2_TOOLCHAIN_HEADERS_AT_LEAST_3_17
```

## package/aws-iot-device-sdk-cpp/Config.in
```kconfig
config BR2_PACKAGE_AWS_IOT_DEVICE_SDK_CPP
	bool "aws-iot-device-sdk-cpp"
	depends on BR2_INSTALL_LIBSTDCPP # aws-crt-cpp
	depends on BR2_TOOLCHAIN_HAS_THREADS_NPTL # aws-c-common -> pthread_setaffinity_np
	select BR2_PACKAGE_AWS_C_IO
	select BR2_PACKAGE_AWS_CRT_CPP
	help
	  The Device SDK simplifies access to the Pub/Sub functionality
	  of the AWS IoT broker via MQTT and provides APIs to interact
	  with Thing Shadows. The SDK has been tested to work with the
	  AWS IoT platform to ensure best interoperability of a device
	  with the AWS IoT platform.

	  NOTE: A new AWS IoT Device SDK is now available. It is a
	        complete rework, built to improve reliability,
	        performance, and security. This SDK will no longer
	        receive feature updates, but will receive security
	        updates.

	  https://github.com/aws/aws-iot-device-sdk-cpp

comment "aws-iot-device-sdk-cpp needs a toolchain w/ NPTL, C++"
	depends on !BR2_INSTALL_LIBSTDCPP || !BR2_TOOLCHAIN_HAS_THREADS_NPTL
```

## package/aws-iot-device-sdk-python-v2/Config.in
```kconfig
config BR2_PACKAGE_AWS_IOT_DEVICE_SDK_PYTHON_V2
	bool "aws-iot-device-sdk-python-v2"
	depends on BR2_INSTALL_LIBSTDCPP
	depends on BR2_TOOLCHAIN_HAS_THREADS # aws-crt-python -> aws-c-common
	depends on BR2_PACKAGE_PYTHON3
	select BR2_PACKAGE_AWS_CRT_PYTHON
	help
	  Next generation AWS IoT SDK based on the AWS Common Runtime

	  https://github.com/aws/aws-iot-device-sdk-python-v2

comment "aws-iot-device-sdk-python-v2 needs a toolchain w/ threads, C++"
	depends on !BR2_INSTALL_LIBSTDCPP || !BR2_TOOLCHAIN_HAS_THREADS
```

## package/aws-iot-securetunneling-localproxy/Config.in
```kconfig
config BR2_PACKAGE_AWS_IOT_SECURETUNNELING_LOCALPROXY
	bool "aws-iot-securetunneling-localproxy"
	depends on BR2_PACKAGE_PROTOBUF_ARCH_SUPPORTS
	depends on BR2_TOOLCHAIN_HAS_THREADS # boost, protobuf-c
	depends on BR2_TOOLCHAIN_GCC_AT_LEAST_4_8 # C++11
	depends on BR2_INSTALL_LIBSTDCPP # boost-1.69, protobuf
	depends on !BR2_STATIC_LIBS # protobuf
	depends on !BR2_PACKAGE_BOOST
	select BR2_PACKAGE_BOOST_1_69
	select BR2_PACKAGE_BOOST_1_69_SYSTEM
	select BR2_PACKAGE_BOOST_1_69_LOG
	select BR2_PACKAGE_BOOST_1_69_THREAD
	select BR2_PACKAGE_BOOST_1_69_PROGRAM_OPTIONS
	select BR2_PACKAGE_BOOST_1_69_DATE_TIME
	select BR2_PACKAGE_BOOST_1_69_FILESYSTEM
	select BR2_PACKAGE_PROTOBUF
	help
	  Example C++ implementation of a local proxy for the AWS IoT
	  Secure Tunneling service

	  https://github.com/aws-samples/aws-iot-securetunneling-localproxy

comment "aws-iot-securetunneling-localproxy is not compatible with boost >= 1.70"
	depends on BR2_PACKAGE_BOOST

comment "aws-iot-securetunneling-localproxy needs a toolchain w/ C++, threads, dynamic library, gcc >= 4.8"
	depends on !BR2_INSTALL_LIBSTDCPP || !BR2_TOOLCHAIN_HAS_THREADS \
		|| BR2_STATIC_LIBS || !BR2_TOOLCHAIN_GCC_AT_LEAST_4_8
	depends on BR2_PACKAGE_PROTOBUF_ARCH_SUPPORTS
```

## package/aws-sdk-cpp/Config.in
```kconfig
config BR2_PACKAGE_AWS_SDK_CPP
	bool "aws-sdk-cpp"
	depends on BR2_INSTALL_LIBSTDCPP
	depends on BR2_TOOLCHAIN_HAS_THREADS_NPTL # aws-c-common -> pthread_setaffinity_np
	depends on !BR2_TOOLCHAIN_USES_MUSL # aws-c-common -> pthread_attr_setaffinity_np
	select BR2_PACKAGE_AWS_C_CAL
	select BR2_PACKAGE_AWS_C_EVENT_STREAM
	select BR2_PACKAGE_ZLIB
	help
	  The AWS SDK for C++ provides a modern C++ (C++ 11 or later)
	  interface for Amazon Web Services (AWS). It is meant to be
	  performant and fully functioning with low- and high-level
	  SDKs, while minimizing dependencies and providing platform
	  portability (Windows, OSX, Linux, and mobile).

	  https://github.com/aws/aws-sdk-cpp

if BR2_PACKAGE_AWS_SDK_CPP

config BR2_PACKAGE_AWS_SDK_CPP_HTTP_CLIENT
	bool "http client"
	select BR2_PACKAGE_LIBCURL
	help
	  If disabled, no platform-default http client will be included
	  in the library.  For the library to be used you will need to
	  provide your own platform-specific implementation

config BR2_PACKAGE_AWS_SDK_CPP_TEXT_TO_SPEECH
	bool "text-to-speech support"
	depends on BR2_PACKAGE_PULSEAUDIO_HAS_ATOMIC # pulseaudio
	depends on BR2_USE_WCHAR # pulseaudio
	depends on !BR2_STATIC_LIBS # pulseaudio
	depends on BR2_USE_MMU # pulseaudio -> fork()
	select BR2_PACKAGE_PULSEAUDIO
	help
	  text-to-speech plugin

comment "text-to-speech support needs a toolchain w/ wchar, threads, dynamic library"
	depends on BR2_USE_MMU
	depends on BR2_PACKAGE_PULSEAUDIO_HAS_ATOMIC
	depends on !BR2_USE_WCHAR || !BR2_TOOLCHAIN_HAS_THREADS || BR2_STATIC_LIBS

endif

comment "aws-sdk-cpp needs a glibc or uClibc toolchain w/ NPTL, C++"
	depends on !BR2_INSTALL_LIBSTDCPP || !BR2_TOOLCHAIN_HAS_THREADS_NPTL || \
		BR2_TOOLCHAIN_USES_MUSL
```

## package/aws-sdk-go/Config.in
```kconfig
config BR2_PACKAGE_AWS_SDK_GO
	bool "amazon-sdk-go"
	depends on BR2_PACKAGE_HOST_GO_TARGET_ARCH_SUPPORTS
	depends on BR2_PACKAGE_HOST_GO_TARGET_CGO_LINKING_SUPPORTS
	help
	  aws-sdk-go is the official AWS SDK for the Go programming
	  language.

	  https://github.com/aws/aws-sdk-go
```

## package/aws-sdk-java-v2/Config.in
```kconfig
config BR2_PACKAGE_AWS_SDK_JAVA_V2
	bool "aws-sdk-java-v2"
	depends on BR2_PACKAGE_OPENJDK
	help
	  The AWS SDK for Java 2.0 is a rewrite of 1.0 with some great
	  new features. As with version 1.0, it enables you to easily
	  work with Amazon Web Services but also includes features like
	  non-blocking IO and pluggable HTTP implementation to further
	  customize your applications.

	  https://github.com/aws/aws-sdk-java-v2

comment "aws-sdk-java-v2 needs java"
	depends on !BR2_PACKAGE_OPENJDK
```

## package/s2n/Config.in
```kconfig
config BR2_PACKAGE_S2N
	bool "s2n"
	depends on BR2_TOOLCHAIN_HAS_THREADS_NPTL # aws-c-common -> pthread_setaffinity_np
	select BR2_PACKAGE_OPENSSL
	help
	  s2n is a C99 implementation of the TLS/SSL protocols that is
	  designed to be simple, small, fast, and with security as a
	  priority. It is released and licensed under the Apache
	  License 2.0.

	  https://github.com/awslabs/s2n

comment "s2n needs a toolchain w/ NPTL"
	depends on !BR2_TOOLCHAIN_HAS_THREADS_NPTL
```

## package/usrsctp/Config.in
```kconfig
config BR2_PACKAGE_USRSCTP
	bool "usrsctp"
	help
	  A portable SCTP userland stack

	  https://github.com/sctplab/usrsctp

if BR2_PACKAGE_USRSCTP

config BR2_PACKAGE_USRSCTP_EXAMPLE_PROGRAMS
	bool "example-programs"

endif
```
