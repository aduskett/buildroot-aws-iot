## aws/package/amazon-corretto-bin/Config.in
```kconfig
config BR2_PACKAGE_HOST_AMAZON_CORRETTO_BIN_ARCH_SUPPORTS
	bool
	default y if BR2_HOSTARCH = "x86_64"

config BR2_PACKAGE_AMAZON_CORRETTO_BIN_18_ARCH_SUPPORTS
	bool
	default y if BR2_aarch64
	default y if BR2_x86_64

config BR2_PACKAGE_AMAZON_CORRETTO_BIN_17_ARCH_SUPPORTS
	bool
	default y if BR2_aarch64
	default y if BR2_x86_64

config BR2_PACKAGE_AMAZON_CORRETTO_BIN_11_ARCH_SUPPORTS
	bool
	default y if BR2_aarch64
	default y if BR2_ARM_CPU_ARMV7A || BR2_ARM_CPU_ARMV7M
	default y if BR2_i386 || BR2_x86_64

config BR2_PACKAGE_AMAZON_CORRETTO_BIN_8_ARCH_SUPPORTS
	bool
	default y if BR2_aarch64
	default y if BR2_x86_64

config BR2_PACKAGE_AMAZON_CORRETTO_BIN
	bool "amazon-corretto"
	help
	  Amazon Corretto is a no-cost, multiplatform, production-ready
	  distribution of the Open Java Development Kit (OpenJDK).

	  https://docs.aws.amazon.com/corretto/

if BR2_PACKAGE_AMAZON_CORRETTO_BIN

choice
	prompt "Corretto version"
	default BR2_AMAZON_CORRETTO_BIN_VERSION_18
	help
	  Select the version of Corretto you wish to use.

config BR2_AMAZON_CORRETTO_BIN_VERSION_18
	bool "18"
	depends on BR2_PACKAGE_AMAZON_CORRETTO_BIN_18_ARCH_SUPPORTS

config BR2_AMAZON_CORRETTO_BIN_VERSION_17
	bool "17"
	depends on BR2_PACKAGE_AMAZON_CORRETTO_BIN_17_ARCH_SUPPORTS

config BR2_AMAZON_CORRETTO_BIN_VERSION_11
	bool "11"
	depends on BR2_PACKAGE_AMAZON_CORRETTO_BIN_11_ARCH_SUPPORTS

config BR2_AMAZON_CORRETTO_BIN_VERSION_8
	bool "8"
	depends on BR2_PACKAGE_AMAZON_CORRETTO_BIN_8_ARCH_SUPPORTS

endchoice

config BR2_PACKAGE_AMAZON_CORRETTO_BIN_ARCH
	string
	default "aarch64" if BR2_ARM_CPU_ARMV8A
	default "armv7" if BR2_ARM_CPU_ARMV7A || BR2_ARM_CPU_ARMV7M
	default "x64" if BR2_x86_64
	default "x86" if BR2_i386

endif
```

## aws/package/amazon-kinesis-producer/Config.in
```kconfig
config BR2_PACKAGE_AMAZON_KINESIS_PRODUCER
	bool "amazon-kinesis-producer"
	depends on BR2_TOOLCHAIN_USES_GLIBC # aws-sdk-cpp
	depends on BR2_INSTALL_LIBSTDCPP # aws-sdk-cpp
	depends on !BR2_STATIC_LIBS # dlopen()
	depends on BR2_TOOLCHAIN_HAS_THREADS
	depends on BR2_TOOLCHAIN_GCC_AT_LEAST_4_8 # C++11
	depends on BR2_TOOLCHAIN_SUPPORTS_ALWAYS_LOCKFREE_ATOMIC_INTS
	depends on !BR2_TOOLCHAIN_HAS_GCC_BUG_64735 # boost-thread
	depends on BR2_TOOLCHAIN_HAS_THREADS_NPTL # boost log
	depends on BR2_USE_WCHAR # boost
	depends on BR2_PACKAGE_PROTOBUF_ARCH_SUPPORTS
	select BR2_PACKAGE_AWS_C_MQTT
	select BR2_PACKAGE_AWS_C_MQTT_WEBSOCKETS
	select BR2_PACKAGE_AWS_SDK_CPP
	select BR2_PACKAGE_BOOST
	select BR2_PACKAGE_BOOST_CHRONO
	select BR2_PACKAGE_BOOST_FILESYSTEM
	select BR2_PACKAGE_BOOST_LOG
	select BR2_PACKAGE_BOOST_RANDOM
	select BR2_PACKAGE_BOOST_REGEX
	select BR2_PACKAGE_BOOST_SYSTEM
	select BR2_PACKAGE_BOOST_TEST
	select BR2_PACKAGE_BOOST_THREAD
	select BR2_PACKAGE_LIBCURL
	select BR2_PACKAGE_LIBOPENSSL
	select BR2_PACKAGE_PROTOBUF
	select BR2_PACKAGE_UTIL_LINUX
	select BR2_PACKAGE_UTIL_LINUX_LIBUUID
	help
	  The Amazon Kinesis Producer Library (KPL) performs many tasks
	  common to creating efficient and reliable producers for Amazon
	  Kinesis. By using the KPL, customers do not need to develop
	  the same logic every time they create a new application for
	  data ingestion.

	  https://github.com/awslabs/amazon-kinesis-producer

comment "amazon-kinesis-producer needs a glibc toolchain w/ C++, threads, dynamic library, NPTL, gcc >= 4.8"
	depends on !BR2_TOOLCHAIN_USES_GLIBC || !BR2_INSTALL_LIBSTDCPP \
		|| !BR2_TOOLCHAIN_HAS_THREADS || BR2_STATIC_LIBS || \
		!BR2_TOOLCHAIN_GCC_AT_LEAST_4_8
	depends on BR2_TOOLCHAIN_SUPPORTS_ALWAYS_LOCKFREE_ATOMIC_INTS
	depends on !BR2_TOOLCHAIN_HAS_THREADS_NPTL
	depends on BR2_PACKAGE_PROTOBUF_ARCH_SUPPORTS

comment "amazon-kinesis-producer needs a toolchain not affected by GCC bug 64735"
	depends on BR2_TOOLCHAIN_HAS_GCC_BUG_64735
```

## aws/package/amazon-kinesis-video-streams-pic/Config.in
```kconfig
config BR2_PACKAGE_AMAZON_KINESIS_VIDEO_STREAMS_PIC
	bool "amazon-kinesis-video-streams-pic"
	help
	  Platform Indendent Code for Amazon Kinesis Video Streams

	  https://github.com/awslabs/amazon-kinesis-video-streams-pic
```

## aws/package/amazon-kinesis-video-streams-producer-sdk-cpp/Config.in
```kconfig
config BR2_PACKAGE_AMAZON_KINESIS_VIDEO_STREAMS_PRODUCER_SDK_CPP
	bool "amazon-kinesis-video-streams-producer-sdk-cpp"
	depends on BR2_INSTALL_LIBSTDCPP
	depends on BR2_USE_WCHAR
	depends on BR2_TOOLCHAIN_HAS_THREADS
	depends on BR2_TOOLCHAIN_GCC_AT_LEAST_4_8 # C++11
	depends on !BR2_TOOLCHAIN_HAS_GCC_BUG_64735 # std::future
	select BR2_PACKAGE_AMAZON_KINESIS_VIDEO_STREAMS_PRODUCER_C
	select BR2_PACKAGE_LIBCURL
	select BR2_PACKAGE_OPENSSL
	select BR2_PACKAGE_LOG4CPLUS
	help
	  Amazon Kinesis Video Streams Producer SDK for C++ is for
	  developers to install and customize for their connected camera
	  and other devices to securely stream video, audio, and
	  time-encoded data to Kinesis Video Streams.

	  https://github.com/awslabs/amazon-kinesis-video-streams-producer-sdk-cpp

if BR2_PACKAGE_AMAZON_KINESIS_VIDEO_STREAMS_PRODUCER_SDK_CPP

config AMAZON_KINESIS_VIDEO_STREAMS_PRODUCER_SDK_CPP_GSTREAMER_PLUGIN
	bool "gstreamer1 plugin"
	depends on BR2_USE_MMU # gstreamer1 -> glib2
	depends on !BR2_TOOLCHAIN_USES_MUSL
	depends on !BR2_STATIC_LIBS
	select BR2_PACKAGE_GSTREAMER1
	select BR2_PACKAGE_GST1_PLUGINS_BASE
	help
	  Build kvssink GStreamer plugin

comment "gstreamer1 plugin needs glibc or uClibc toolchain w/ dynamic library"
	depends on BR2_TOOLCHAIN_USES_MUSL || BR2_STATIC_LIBS

if AMAZON_KINESIS_VIDEO_STREAMS_PRODUCER_SDK_CPP_GSTREAMER_PLUGIN

config AMAZON_KINESIS_VIDEO_STREAMS_PRODUCER_SDK_CPP_GSTREAMER_EXAMPLES
	bool "install example gstreamer programs"

endif

endif # BR2_PACKAGE_AMAZON_KINESIS_VIDEO_STREAMS_PRODUCER_SDK_CPP

comment "amazon-kinesis-video-streams-producer-sdk-cpp needs a toolchain w/ C++, wchar, threads, gcc >= 4.8"
	depends on !BR2_INSTALL_LIBSTDCPP || !BR2_USE_WCHAR || \
		!BR2_TOOLCHAIN_HAS_THREADS || !BR2_TOOLCHAIN_GCC_AT_LEAST_4_8

comment "amazon-kinesis-video-streams-producer-sdk-cpp needs a toolchain not affected by GCC bug 64735"
	depends on BR2_TOOLCHAIN_HAS_GCC_BUG_64735
```

## aws/package/amazon-ssm-agent/Config.in
```kconfig
config BR2_PACKAGE_AMAZON_SSM_AGENT
	bool "amazon-ssm-agent"
	depends on BR2_USE_MMU # sudo
	depends on BR2_PACKAGE_HOST_GO_TARGET_ARCH_SUPPORTS
	depends on BR2_PACKAGE_HOST_GO_TARGET_CGO_LINKING_SUPPORTS
	select BR2_PACKAGE_SUDO # runtime
	help
	  The SSM Agent runs on EC2 instances and enables you to quickly
	  and easily execute remote commands or scripts against one or
	  more instances. The agent uses SSM documents. When you execute
	  a command, the agent on the instance processes the document
	  and configures the instance as specified. Currently, the agent
	  and Run Command enable you to quickly run Shell scripts on an
	  instance using the AWS-RunShellScript SSM document. SSM Agent
	  also enables the Session Manager capability that lets you
	  manage your Amazon EC2 instance through an interactive
	  one-click browser-based shell or through the AWS CLI. When the
	  agent starts, it will create a user called "ssm-user" with
	  sudo or administrator privilege. Session Manager sessions will
	  be launched in context of this user.

	  https://github.com/aws/amazon-ssm-agent
```

## aws/package/apl-core-library/Config.in
```kconfig
config BR2_PACKAGE_APL_CORE_LIBRARY
	bool "apl-core-library"
	depends on BR2_INSTALL_LIBSTDCPP # aws-crt-cpp
	depends on BR2_TOOLCHAIN_HAS_THREADS
	select BR2_PACKAGE_RAPIDJSON
	help
	  APL Core Library enables device makers to create their own
	  "APL viewhost", bringing Alexa experiences with visual
	  renderings to new devices or platforms using any programming
	  language that can invoke C/C++ code.

	  https://github.com/alexa/apl-core-library

comment "aws-iot-device-sdk-cpp needs a toolchain w/ threads, C++"
	depends on !BR2_INSTALL_LIBSTDCPP || !BR2_TOOLCHAIN_HAS_THREADS
```

## aws/package/avs-device-sdk/Config.in
```kconfig
config BR2_PACKAGE_AVS_DEVICE_SDK
	bool "avs-device-sdk"
	depends on BR2_INSTALL_LIBSTDCPP # aws-crt-cpp
	depends on BR2_TOOLCHAIN_HAS_THREADS
	select BR2_PACKAGE_LIBCURL
	select BR2_PACKAGE_SQLITE
	help
	  The Alexa Voice Service (AVS) enables developers to integrate
	  Alexa directly into their products, bringing the convenience
	  of voice control to any connected device. AVS provides
	  developers with access to a suite of resources to build
	  Alexa-enabled products, including APIs, hardware development
	  kits, software development kits, and documentation.

	  https://github.com/alexa/avs-device-sdk

comment "aws-iot-device-sdk-cpp needs a toolchain w/ threads, C++"
	depends on !BR2_INSTALL_LIBSTDCPP || !BR2_TOOLCHAIN_HAS_THREADS
```

## aws/package/aws-c-auth/Config.in
```kconfig
config BR2_PACKAGE_AWS_C_AUTH
	bool "aws-c-auth"
	select BR2_PACKAGE_AWS_C_CAL
	select BR2_PACKAGE_AWS_C_HTTP
	help
	  C99 library implementation of AWS client-side authentication:
	  standard credentials providers and signing.

	  https://github.com/awslabs/aws-c-auth
```

## aws/package/aws-c-cal/Config.in
```kconfig
config BR2_PACKAGE_AWS_C_CAL
	bool "aws-c-cal"
	select BR2_PACKAGE_AWS_C_COMMON
	select BR2_PACKAGE_OPENSSL
	help
	  AWS Crypto Abstraction Layer: Cross-Platform, C99 wrapper for
	  cryptography primitives.

	  https://github.com/awslabs/aws-c-cal
```

## aws/package/aws-c-common/Config.in
```kconfig
config BR2_PACKAGE_AWS_C_COMMON
	bool "aws-c-common"
	help
	  Core c99 package for AWS SDK for C. Includes
	  cross-platform primitives, configuration, data structures,
	  and error handling.

	  https://github.com/awslabs/aws-c-common
```

## aws/package/aws-c-compression/Config.in
```kconfig
config BR2_PACKAGE_AWS_C_COMPRESSION
	bool "aws-c-compression"
	select BR2_PACKAGE_AWS_C_COMMON
	help
	  This is a cross-platform C99 implementation of compression
	  algorithms such as gzip, and huffman encoding/decoding.
	  Currently only huffman is implemented.

	  https://github.com/awslabs/aws-c-compression
```

## aws/package/aws-c-event-stream/Config.in
```kconfig
config BR2_PACKAGE_AWS_C_EVENT_STREAM
	bool "aws-c-event-stream"
	select BR2_PACKAGE_AWS_C_COMMON
	select BR2_PACKAGE_AWS_C_IO
	select BR2_PACKAGE_AWS_CHECKSUMS
	help
	  C99 implementation of the vnd.amazon.event-stream
	  content-type.

	  https://github.com/awslabs/aws-c-event-stream
```

## aws/package/aws-c-http/Config.in
```kconfig
config BR2_PACKAGE_AWS_C_HTTP
	bool "aws-c-http"
	select BR2_PACKAGE_AWS_C_COMPRESSION
	select BR2_PACKAGE_AWS_C_IO
	help
	  C99 implementation of the HTTP/1.1 and HTTP/2 specifications

	  https://github.com/awslabs/aws-c-http
```

## aws/package/aws-c-iot/Config.in
```kconfig
config BR2_PACKAGE_AWS_C_IOT
	bool "aws-c-iot"
	select BR2_PACKAGE_AWS_C_MQTT
	help
	  C99 implementation of AWS IoT cloud services integration with
	  devices

	  https://github.com/awslabs/aws-c-iot
```

## aws/package/aws-c-mqtt/Config.in
```kconfig
config BR2_PACKAGE_AWS_C_MQTT
	bool "aws-c-mqtt"
	select BR2_PACKAGE_AWS_C_IO
	help
	  C99 implementation of the MQTT/1.1 and MQTT/2 specifications

	  https://github.com/awslabs/aws-c-mqtt

if BR2_PACKAGE_AWS_C_MQTT

config BR2_PACKAGE_AWS_C_MQTT_WEBSOCKETS
	bool "websocket support"
	select BR2_PACKAGE_AWS_C_HTTP
	help
	  Enable MQTT connections over websockets.

endif
```

## aws/package/aws-c-s3/Config.in
```kconfig
config BR2_PACKAGE_AWS_C_S3
	bool "aws-c-s3"
	select BR2_PACKAGE_AWS_C_AUTH
	help
	  C99 library implementation for communicating with the S3
	  service, designed for maximizing throughput on high
	  bandwidth EC2 instances.

	  https://github.com/awslabs/aws-c-s3
```

## aws/package/aws-c-sdkutils/Config.in
```kconfig
config BR2_PACKAGE_AWS_C_SDKUTILS
	bool "aws-c-sdkutils"
	select BR2_PACKAGE_AWS_C_COMMON
	help

	  https://github.com/awslabs/aws-c-sdkutils
```

## aws/package/aws-checksums/Config.in
```kconfig
config BR2_PACKAGE_AWS_CHECKSUMS
	bool "aws-checksums"
	select BR2_PACKAGE_AWS_C_COMMON
	help
	  Cross-Platform HW accelerated CRC32c and CRC32 with fallback
	  to efficient SW implementations. C interface with language
	  bindings for each of our SDKs

	  https://github.com/awslabs/aws-checksums
```

## aws/package/aws-crt-cpp/Config.in
```kconfig
config BR2_PACKAGE_AWS_CRT_CPP
	bool "aws-crt-cpp"
	depends on BR2_INSTALL_LIBSTDCPP
	select BR2_PACKAGE_AWS_C_AUTH
	select BR2_PACKAGE_AWS_C_CAL
	select BR2_PACKAGE_AWS_C_COMMON
	select BR2_PACKAGE_AWS_C_EVENT_STREAM
	select BR2_PACKAGE_AWS_CHECKSUMS
	select BR2_PACKAGE_AWS_C_HTTP
	select BR2_PACKAGE_AWS_C_IO
	select BR2_PACKAGE_AWS_C_MQTT
	select BR2_PACKAGE_AWS_C_S3
	select BR2_PACKAGE_OPENSSL
	help
	  C++ wrapper around the aws-c-* libraries. Provides
	  Cross-Platform Transport Protocols and SSL/TLS
	  implementations for C++.

	  https://github.com/awslabs/aws-crt-cpp

comment "aws-crt-cpp needs a toolchain w/ C++"
	depends on !BR2_INSTALL_LIBSTDCPP
```
