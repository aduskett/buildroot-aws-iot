## Config.in
```kconfig
menu "AWS-IOT libraries"
source "$BR2_EXTERNAL_AWS_IOT_PATH/package/aws-c-auth/Config.in"
source "$BR2_EXTERNAL_AWS_IOT_PATH/package/aws-c-cal/Config.in"
source "$BR2_EXTERNAL_AWS_IOT_PATH/package/aws-c-common/Config.in"
source "$BR2_EXTERNAL_AWS_IOT_PATH/package/aws-c-compression/Config.in"
source "$BR2_EXTERNAL_AWS_IOT_PATH/package/aws-c-event-stream/Config.in"
source "$BR2_EXTERNAL_AWS_IOT_PATH/package/aws-c-http/Config.in"
source "$BR2_EXTERNAL_AWS_IOT_PATH/package/aws-c-io/Config.in"
source "$BR2_EXTERNAL_AWS_IOT_PATH/package/aws-c-mqtt/Config.in"
source "$BR2_EXTERNAL_AWS_IOT_PATH/package/aws-c-s3/Config.in"
source "$BR2_EXTERNAL_AWS_IOT_PATH/package/aws-checksums/Config.in"
source "$BR2_EXTERNAL_AWS_IOT_PATH/package/aws-crt-cpp/Config.in"
source "$BR2_EXTERNAL_AWS_IOT_PATH/package/aws-crt-python/Config.in"
source "$BR2_EXTERNAL_AWS_IOT_PATH/package/s2n/Config.in"
endmenu

menu "AWS-IOT greengrass packages"
source "$BR2_EXTERNAL_AWS_IOT_PATH/package/aws-greengrass-core/Config.in"
endmenu

menu "AWS-IOT SDK packages"
source "$BR2_EXTERNAL_AWS_IOT_PATH/package/aws-greengrass-core-sdk-c/Config.in"
source "$BR2_EXTERNAL_AWS_IOT_PATH/package/aws-greengrass-core-sdk-python/Config.in"
source "$BR2_EXTERNAL_AWS_IOT_PATH/package/aws-iot-device-sdk-cpp/Config.in"
source "$BR2_EXTERNAL_AWS_IOT_PATH/package/aws-iot-device-sdk-cpp-v2/Config.in"
source "$BR2_EXTERNAL_AWS_IOT_PATH/package/aws-iot-device-sdk-python-v2/Config.in"
source "$BR2_EXTERNAL_AWS_IOT_PATH/package/aws-sdk-cpp/Config.in"
source "$BR2_EXTERNAL_AWS_IOT_PATH/package/aws-sdk-go/Config.in"
source "$BR2_EXTERNAL_AWS_IOT_PATH/package/aws-sdk-go-v2/Config.in"
source "$BR2_EXTERNAL_AWS_IOT_PATH/package/aws-sdk-java-v2/Config.in"
endmenu

menu "AWS-IOT programs"
source "$BR2_EXTERNAL_AWS_IOT_PATH/package/amazon-ssm-agent/Config.in"
source "$BR2_EXTERNAL_AWS_IOT_PATH/package/aws-iot-securetunneling-localproxy/Config.in"
endmenu

menu "system libraries"
source "$BR2_EXTERNAL_AWS_IOT_PATH/package/boost-1-69/Config.in"
endmenu
```

## aws/Config.in
```kconfig
menu "AWS libraries"
source "$BR2_EXTERNAL_AWS_IOT_PATH/package/aws-c-auth/Config.in"
source "$BR2_EXTERNAL_AWS_IOT_PATH/package/aws-c-cal/Config.in"
source "$BR2_EXTERNAL_AWS_IOT_PATH/package/aws-c-common/Config.in"
source "$BR2_EXTERNAL_AWS_IOT_PATH/package/aws-c-compression/Config.in"
source "$BR2_EXTERNAL_AWS_IOT_PATH/package/aws-c-event-stream/Config.in"
source "$BR2_EXTERNAL_AWS_IOT_PATH/package/aws-checksums/Config.in"
source "$BR2_EXTERNAL_AWS_IOT_PATH/package/aws-c-http/Config.in"
source "$BR2_EXTERNAL_AWS_IOT_PATH/package/aws-c-io/Config.in"
source "$BR2_EXTERNAL_AWS_IOT_PATH/package/aws-c-mqtt/Config.in"
source "$BR2_EXTERNAL_AWS_IOT_PATH/package/aws-crt-cpp/Config.in"
source "$BR2_EXTERNAL_AWS_IOT_PATH/package/aws-crt-python/Config.in"
source "$BR2_EXTERNAL_AWS_IOT_PATH/package/aws-c-s3/Config.in"
source "$BR2_EXTERNAL_AWS_IOT_PATH/package/aws-lc/Config.in"
source "$BR2_EXTERNAL_AWS_IOT_PATH/package/s2n/Config.in"
endmenu

menu "AWS-IOT libraries"
source "$BR2_EXTERNAL_AWS_IOT_PATH/package/aws-c-iot/Config.in"
endmenu

menu "AWS Greengrass packages"
source "$BR2_EXTERNAL_AWS_IOT_PATH/package/aws-greengrass-core/Config.in"
source "$BR2_EXTERNAL_AWS_IOT_PATH/package/aws-greengrass-core-v2/Config.in"
endmenu

menu "AWS Greengrass SDK packages"
source "$BR2_EXTERNAL_AWS_IOT_PATH/package/aws-greengrass-core-sdk-c/Config.in"
source "$BR2_EXTERNAL_AWS_IOT_PATH/package/aws-greengrass-core-sdk-python/Config.in"
endmenu

menu "AWS SDK packages"
source "$BR2_EXTERNAL_AWS_IOT_PATH/package/aws-sdk-cpp/Config.in"
source "$BR2_EXTERNAL_AWS_IOT_PATH/package/aws-sdk-go/Config.in"
source "$BR2_EXTERNAL_AWS_IOT_PATH/package/aws-sdk-go-v2/Config.in"
source "$BR2_EXTERNAL_AWS_IOT_PATH/package/aws-sdk-java/Config.in"
source "$BR2_EXTERNAL_AWS_IOT_PATH/package/aws-sdk-java-v2/Config.in"
endmenu

menu "AWS-IOT SDK packages"
source "$BR2_EXTERNAL_AWS_IOT_PATH/package/aws-iot-device-sdk-cpp/Config.in"
source "$BR2_EXTERNAL_AWS_IOT_PATH/package/aws-iot-device-sdk-cpp-v2/Config.in"
source "$BR2_EXTERNAL_AWS_IOT_PATH/package/aws-iot-device-sdk-python-v2/Config.in"
endmenu

menu "Kinesis packages"
source "$BR2_EXTERNAL_AWS_IOT_PATH/package/amazon-kinesis-video-streams-pic/Config.in"
source "$BR2_EXTERNAL_AWS_IOT_PATH/package/amazon-kinesis-video-streams-producer-c/Config.in"
source "$BR2_EXTERNAL_AWS_IOT_PATH/package/amazon-kinesis-video-streams-producer-sdk-cpp/Config.in"
source "$BR2_EXTERNAL_AWS_IOT_PATH/package/amazon-kinesis-video-streams-webrtc-sdk-c/Config.in"
endmenu

menu "AWS-IOT programs"
source "$BR2_EXTERNAL_AWS_IOT_PATH/package/aws-iot-device-client/Config.in"
source "$BR2_EXTERNAL_AWS_IOT_PATH/package/aws-iot-securetunneling-localproxy/Config.in"
endmenu

menu "Interpreter languages and scripting"
source "$BR2_EXTERNAL_AWS_IOT_PATH/package/amazon-corretto-bin/Config.in"
endmenu

menu "system libraries"
source "$BR2_EXTERNAL_AWS_IOT_PATH/package/usrsctp/Config.in"
endmenu
```

## aws/configs/greengrass_qemu_x86_64_defconfig
```kconfig
BR2_x86_64=y
BR2_SHARED_STATIC_LIBS=y
BR2_TOOLCHAIN_BUILDROOT_GLIBC=y
BR2_BINUTILS_VERSION_2_35_X=y
BR2_GCC_VERSION_10_X=y
BR2_TOOLCHAIN_BUILDROOT_CXX=y
BR2_INIT_SYSTEMD=y
BR2_SYSTEM_BIN_SH_BASH=y
BR2_TARGET_GENERIC_GETTY_PORT="tty1"
BR2_SYSTEM_DEFAULT_PATH="/bin:/sbin:/usr/bin:/usr/sbin"
BR2_ROOTFS_POST_BUILD_SCRIPT="aws/board/greengrass-qemu-x86_64/post-build.sh"
BR2_ROOTFS_POST_IMAGE_SCRIPT="aws/board/greengrass-qemu-x86_64/post-image.sh"
BR2_LINUX_KERNEL=y
BR2_LINUX_KERNEL_CUSTOM_VERSION=y
BR2_LINUX_KERNEL_CUSTOM_VERSION_VALUE="5.10.12"
BR2_LINUX_KERNEL_USE_CUSTOM_CONFIG=y
BR2_LINUX_KERNEL_CUSTOM_CONFIG_FILE="aws/board/greengrass-qemu-x86_64/linux.config"
BR2_LINUX_KERNEL_INSTALL_TARGET=y
BR2_LINUX_KERNEL_NEEDS_HOST_OPENSSL=y
BR2_PACKAGE_XORG7=y
BR2_PACKAGE_LINUX_FIRMWARE=y
BR2_PACKAGE_LINUX_FIRMWARE_ATHEROS_9170=y
BR2_PACKAGE_LINUX_FIRMWARE_ATHEROS_9271=y
BR2_PACKAGE_LINUX_FIRMWARE_IWLWIFI_3160=y
BR2_PACKAGE_LINUX_FIRMWARE_IWLWIFI_3168=y
BR2_PACKAGE_LINUX_FIRMWARE_IWLWIFI_5000=y
BR2_PACKAGE_LINUX_FIRMWARE_IWLWIFI_6000G2A=y
BR2_PACKAGE_LINUX_FIRMWARE_IWLWIFI_6000G2B=y
BR2_PACKAGE_LINUX_FIRMWARE_IWLWIFI_7260=y
BR2_PACKAGE_LINUX_FIRMWARE_IWLWIFI_7265D=y
BR2_PACKAGE_LINUX_FIRMWARE_IWLWIFI_8000C=y
BR2_PACKAGE_LINUX_FIRMWARE_IWLWIFI_8265=y
BR2_PACKAGE_LINUX_FIRMWARE_RALINK_RT73=y
BR2_PACKAGE_LINUX_FIRMWARE_RALINK_RT2XX=y
BR2_PACKAGE_LINUX_FIRMWARE_RTL_81XX=y
BR2_PACKAGE_LINUX_FIRMWARE_RTL_87XX=y
BR2_PACKAGE_LINUX_FIRMWARE_RTL_88XX=y
BR2_PACKAGE_LINUX_FIRMWARE_RTL_8169=y
BR2_PACKAGE_ACPID=y
BR2_PACKAGE_OPENJDK=y
BR2_OPENJDK_VERSION_LTS=y
BR2_PACKAGE_CONNMAN=y
BR2_PACKAGE_CONNMAN_WIFI=y
BR2_PACKAGE_CONNMAN_CLIENT=y
BR2_PACKAGE_OPENSSH=y
BR2_PACKAGE_WIRELESS_REGDB=y
BR2_PACKAGE_COREUTILS=y
BR2_TARGET_ROOTFS_EXT2=y
BR2_TARGET_ROOTFS_EXT2_4=y
BR2_TARGET_ROOTFS_EXT2_SIZE="512M"
BR2_TARGET_ROOTFS_EXT2_MKFS_OPTIONS="-O 64bit"
# BR2_TARGET_ROOTFS_TAR is not set
BR2_TARGET_GRUB2=y
BR2_TARGET_GRUB2_X86_64_EFI=y
BR2_PACKAGE_HOST_DOSFSTOOLS=y
BR2_PACKAGE_HOST_GENIMAGE=y
BR2_PACKAGE_HOST_MTOOLS=y
BR2_PACKAGE_AWS_GREENGRASS_CORE_V2=y
```

## aws/configs/test_kinesis_defconfig
```kconfig
BR2_x86_64=y
BR2_x86_corei7_avx=y
BR2_DL_DIR="$(TOPDIR)/aws/dl"
BR2_CCACHE=y
BR2_CCACHE_DIR="/home/br-user/ccache/kinesis_test"
BR2_CCACHE_INITIAL_SETUP="--max-size=5G"
BR2_TOOLCHAIN_EXTERNAL=y
BR2_ROOTFS_MERGED_USR=y
BR2_SYSTEM_BIN_SH_BASH=y
BR2_TARGET_GENERIC_GETTY_PORT="tty1"
BR2_SYSTEM_DEFAULT_PATH="/bin:/sbin:/usr/bin:/usr/sbin"
BR2_TARGET_TZ_INFO=y
BR2_ROOTFS_POST_BUILD_SCRIPT="aws/board/greengrass-qemu-x86_64/post-build.sh"
BR2_ROOTFS_POST_IMAGE_SCRIPT="aws/board/greengrass-qemu-x86_64/post-image.sh"
BR2_LINUX_KERNEL=y
BR2_LINUX_KERNEL_CUSTOM_VERSION=y
BR2_LINUX_KERNEL_CUSTOM_VERSION_VALUE="5.10.76"
BR2_LINUX_KERNEL_USE_CUSTOM_CONFIG=y
BR2_LINUX_KERNEL_CUSTOM_CONFIG_FILE="aws/board/greengrass-qemu-x86_64/linux.config"
BR2_LINUX_KERNEL_INSTALL_TARGET=y
BR2_LINUX_KERNEL_NEEDS_HOST_OPENSSL=y
BR2_PACKAGE_BUSYBOX_SHOW_OTHERS=y
BR2_PACKAGE_LINUX_FIRMWARE=y
BR2_PACKAGE_LINUX_FIRMWARE_ATHEROS_9170=y
BR2_PACKAGE_LINUX_FIRMWARE_ATHEROS_9271=y
BR2_PACKAGE_LINUX_FIRMWARE_IWLWIFI_3160=y
BR2_PACKAGE_LINUX_FIRMWARE_IWLWIFI_3168=y
BR2_PACKAGE_LINUX_FIRMWARE_IWLWIFI_5000=y
BR2_PACKAGE_LINUX_FIRMWARE_IWLWIFI_6000G2A=y
BR2_PACKAGE_LINUX_FIRMWARE_IWLWIFI_6000G2B=y
BR2_PACKAGE_LINUX_FIRMWARE_IWLWIFI_7260=y
BR2_PACKAGE_LINUX_FIRMWARE_IWLWIFI_7265D=y
BR2_PACKAGE_LINUX_FIRMWARE_IWLWIFI_8000C=y
BR2_PACKAGE_LINUX_FIRMWARE_IWLWIFI_8265=y
BR2_PACKAGE_LINUX_FIRMWARE_RALINK_RT73=y
BR2_PACKAGE_LINUX_FIRMWARE_RALINK_RT2XX=y
BR2_PACKAGE_LINUX_FIRMWARE_RTL_81XX=y
BR2_PACKAGE_LINUX_FIRMWARE_RTL_87XX=y
BR2_PACKAGE_LINUX_FIRMWARE_RTL_88XX=y
BR2_PACKAGE_LINUX_FIRMWARE_RTL_8169=y
BR2_PACKAGE_DBUS=y
# BR2_PACKAGE_LIBCURL_PROXY_SUPPORT is not set
# BR2_PACKAGE_LIBCURL_COOKIES_SUPPORT is not set
# BR2_PACKAGE_LIBCURL_EXTRA_PROTOCOLS_FEATURES is not set
BR2_PACKAGE_BOOST_PROGRAM_OPTIONS=y
# BR2_PACKAGE_IFUPDOWN_SCRIPTS is not set
# BR2_PACKAGE_URANDOM_SCRIPTS is not set
BR2_TARGET_ROOTFS_EXT2=y
BR2_TARGET_ROOTFS_EXT2_4=y
BR2_TARGET_ROOTFS_EXT2_SIZE="512M"
BR2_TARGET_ROOTFS_EXT2_MKFS_OPTIONS="-O 64bit"
# BR2_TARGET_ROOTFS_TAR is not set
BR2_TARGET_GRUB2=y
BR2_TARGET_GRUB2_X86_64_EFI=y
BR2_PACKAGE_HOST_DOSFSTOOLS=y
BR2_PACKAGE_HOST_GENIMAGE=y
BR2_PACKAGE_HOST_MTOOLS=y
BR2_PACKAGE_AMAZON_KINESIS_PRODUCER=y
```

## aws/configs/test_uclibc_no_nptl_defconfig
```kconfig
BR2_x86_64=y
BR2_x86_corei7_avx=y
BR2_DL_DIR="$(TOPDIR)/aws/dl"
BR2_CCACHE=y
BR2_CCACHE_DIR="/home/br-user/ccache/uclibc_no_nptl_test"
BR2_CCACHE_INITIAL_SETUP="--max-size=5G"
BR2_PACKAGE_HOST_LINUX_HEADERS_CUSTOM_5_10=y
BR2_TOOLCHAIN_BUILDROOT_WCHAR=y
BR2_PTHREADS=y
BR2_TOOLCHAIN_BUILDROOT_CXX=y
BR2_ROOTFS_MERGED_USR=y
BR2_SYSTEM_BIN_SH_BASH=y
BR2_TARGET_GENERIC_GETTY_PORT="tty1"
BR2_SYSTEM_DEFAULT_PATH="/bin:/sbin:/usr/bin:/usr/sbin"
BR2_TARGET_TZ_INFO=y
BR2_ROOTFS_POST_BUILD_SCRIPT="aws/board/greengrass-qemu-x86_64/post-build.sh"
BR2_ROOTFS_POST_IMAGE_SCRIPT="aws/board/greengrass-qemu-x86_64/post-image.sh"
BR2_LINUX_KERNEL=y
BR2_LINUX_KERNEL_CUSTOM_VERSION=y
BR2_LINUX_KERNEL_CUSTOM_VERSION_VALUE="5.10.76"
BR2_LINUX_KERNEL_USE_CUSTOM_CONFIG=y
BR2_LINUX_KERNEL_CUSTOM_CONFIG_FILE="aws/board/greengrass-qemu-x86_64/linux.config"
BR2_LINUX_KERNEL_INSTALL_TARGET=y
BR2_LINUX_KERNEL_NEEDS_HOST_OPENSSL=y
BR2_PACKAGE_BUSYBOX_SHOW_OTHERS=y
BR2_PACKAGE_LINUX_FIRMWARE=y
BR2_PACKAGE_LINUX_FIRMWARE_ATHEROS_9170=y
BR2_PACKAGE_LINUX_FIRMWARE_ATHEROS_9271=y
BR2_PACKAGE_LINUX_FIRMWARE_IWLWIFI_3160=y
BR2_PACKAGE_LINUX_FIRMWARE_IWLWIFI_3168=y
BR2_PACKAGE_LINUX_FIRMWARE_IWLWIFI_5000=y
BR2_PACKAGE_LINUX_FIRMWARE_IWLWIFI_6000G2A=y
BR2_PACKAGE_LINUX_FIRMWARE_IWLWIFI_6000G2B=y
BR2_PACKAGE_LINUX_FIRMWARE_IWLWIFI_7260=y
BR2_PACKAGE_LINUX_FIRMWARE_IWLWIFI_7265D=y
BR2_PACKAGE_LINUX_FIRMWARE_IWLWIFI_8000C=y
BR2_PACKAGE_LINUX_FIRMWARE_IWLWIFI_8265=y
BR2_PACKAGE_LINUX_FIRMWARE_RALINK_RT73=y
BR2_PACKAGE_LINUX_FIRMWARE_RALINK_RT2XX=y
BR2_PACKAGE_LINUX_FIRMWARE_RTL_81XX=y
BR2_PACKAGE_LINUX_FIRMWARE_RTL_87XX=y
BR2_PACKAGE_LINUX_FIRMWARE_RTL_88XX=y
BR2_PACKAGE_LINUX_FIRMWARE_RTL_8169=y
BR2_PACKAGE_ACPID=y
BR2_PACKAGE_ALSA_LIB=y
BR2_PACKAGE_FONTCONFIG=y
BR2_PACKAGE_GIFLIB=y
BR2_PACKAGE_JPEG=y
BR2_PACKAGE_LCMS2=y
BR2_PACKAGE_LIBPNG=y
BR2_PACKAGE_LIBUSB=y
BR2_PACKAGE_BOOST=y
BR2_PACKAGE_BOOST_DATE_TIME=y
BR2_PACKAGE_BOOST_FILESYSTEM=y
BR2_PACKAGE_BOOST_PROGRAM_OPTIONS=y
BR2_PACKAGE_BOOST_THREAD=y
BR2_PACKAGE_LIBCAP=y
BR2_PACKAGE_PROTOBUF=y
BR2_PACKAGE_XUTIL_UTIL_MACROS=y
BR2_PACKAGE_CUPS=y
BR2_PACKAGE_IPTABLES=y
BR2_PACKAGE_OPENSSH=y
BR2_PACKAGE_WIRELESS_REGDB=y
BR2_PACKAGE_WPA_SUPPLICANT=y
BR2_PACKAGE_WPA_SUPPLICANT_DBUS=y
BR2_PACKAGE_KMOD=y
BR2_PACKAGE_KMOD_TOOLS=y
BR2_PACKAGE_UTIL_LINUX_AGETTY=y
BR2_PACKAGE_UTIL_LINUX_FSCK=y
BR2_TARGET_ROOTFS_EXT2=y
BR2_TARGET_ROOTFS_EXT2_4=y
BR2_TARGET_ROOTFS_EXT2_SIZE="512M"
BR2_TARGET_ROOTFS_EXT2_MKFS_OPTIONS="-O 64bit"
# BR2_TARGET_ROOTFS_TAR is not set
BR2_PACKAGE_HOST_DOSFSTOOLS=y
BR2_PACKAGE_HOST_GENIMAGE=y
BR2_PACKAGE_HOST_MTOOLS=y
BR2_PACKAGE_AWS_C_MQTT_WEBSOCKETS=y
BR2_PACKAGE_AWS_LC=y
BR2_PACKAGE_AWS_GREENGRASS_CORE=y
BR2_PACKAGE_AWS_GREENGRASS_CORE_OTA_AGENT=y
BR2_PACKAGE_AWS_GREENGRASS_CORE_SDK_C=y
BR2_PACKAGE_AWS_SDK_GO=y
BR2_PACKAGE_AWS_SDK_GO_V2=y
BR2_PACKAGE_AWS_IOT_DEVICE_SDK_CPP=y
BR2_PACKAGE_AMAZON_KINESIS_VIDEO_STREAMS_PRODUCER_SDK_CPP=y
AMAZON_KINESIS_VIDEO_STREAMS_PRODUCER_SDK_CPP_GSTREAMER_PLUGIN=y
AMAZON_KINESIS_VIDEO_STREAMS_PRODUCER_SDK_CPP_GSTREAMER_EXAMPLES=y
BR2_PACKAGE_AMAZON_KINESIS_VIDEO_STREAMS_WEBRTC_SDK_C=y
BR2_PACKAGE_AWS_IOT_DEVICE_CLIENT=y
BR2_PACKAGE_AWS_IOT_DEVICE_CLIENT_INSTALL_SETUP_SCRIPT=y
BR2_PACKAGE_AWS_IOT_DEVICE_CLIENT_JOBS=y
BR2_PACKAGE_AWS_IOT_DEVICE_CLIENT_DD=y
BR2_PACKAGE_AWS_IOT_DEVICE_CLIENT_ST=y
BR2_PACKAGE_AWS_IOT_DEVICE_CLIENT_FP=y
BR2_PACKAGE_AWS_IOT_DEVICE_CLIENT_SAMPLES=y
BR2_PACKAGE_AWS_IOT_DEVICE_CLIENT_PUBSUB_SAMPLES=y
BR2_PACKAGE_AWS_IOT_DEVICE_CLIENT_SHADOW=y
BR2_PACKAGE_AWS_IOT_DEVICE_CLIENT_SHADOW_CONFIG=y
BR2_PACKAGE_AWS_IOT_DEVICE_CLIENT_SHADOW_SAMPLES=y
```

## aws/package/alexa-smart-screen-sdk/Config.in
```kconfig
config BR2_PACKAGE_ALEXA_SMART_SCREEN_SDK
	bool "alexa-smart-screen-sdk"
	depends on BR2_TOOLCHAIN_GCC_AT_LEAST_4_8 # websocketpp -> C++11
	depends on BR2_INSTALL_LIBSTDCPP # aws-crt-cpp
	depends on BR2_USE_MMU # libasio
	depends on BR2_USE_WCHAR # libasio
	depends on BR2_TOOLCHAIN_SUPPORTS_ALWAYS_LOCKFREE_ATOMIC_INTS # libasio
	depends on !BR2_TOOLCHAIN_HAS_GCC_BUG_64735 # exception_ptr # libasio
	depends on BR2_TOOLCHAIN_HAS_THREADS
	select BR2_PACKAGE_AVS_DEVICE_SDK
	select BR2_PACKAGE_APL_CORE_LIBRARY
	select BR2_PACKAGE_LIBASIO
	select BR2_PACKAGE_RAPIDJSON
	select BR2_PACKAGE_WEBSOCKETPP
	help
	  APL Core Library enables device makers to create their own
	  "APL viewhost", bringing Alexa experiences with visual
	  renderings to new devices or platforms using any programming
	  language that can invoke C/C++ code.

	  https://github.com/alexa/apl-core-library

comment "alexa-smart-screen-sdk needs a toolchain w/ C++, dynamic library, threads, wchar and gcc >= 4.8"
	depends on BR2_USE_MMU
	depends on BR2_TOOLCHAIN_SUPPORTS_ALWAYS_LOCKFREE_ATOMIC_INTS
	depends on !BR2_INSTALL_LIBSTDCPP || !BR2_TOOLCHAIN_HAS_THREADS || \
		!BR2_USE_WCHAR || !BR2_TOOLCHAIN_GCC_AT_LEAST_4_8

comment "alexa-smart-screen-sdk needs exception_ptr"
	depends on BR2_TOOLCHAIN_HAS_GCC_BUG_64735
```
